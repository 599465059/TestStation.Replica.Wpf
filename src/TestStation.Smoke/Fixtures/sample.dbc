VERSION "1.0"

NS_ :

BS_:
BU_: ECU

BO_ 256 VehicleStatus: 8 ECU
 SG_ Speed : 0|16@1+ (0.01,0) [0|250] "km/h" ECU
 SG_ Temperature : 16|8@1- (1,-40) [-40|215] "degC" ECU
 SG_ MotorolaValue : 23|8@0+ (1,0) [0|255] "raw" ECU
